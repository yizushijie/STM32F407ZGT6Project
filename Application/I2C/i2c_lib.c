#include "i2c_lib.h"

///////////////////////////////////////////////////////////////////////////////
//////函		数：
//////功		能：
//////输入参数:
//////输出参数:
//////说		明：
//////////////////////////////////////////////////////////////////////////////
UINT8_T I2CLib_MSW_Init(I2C_HandleType *I2Cx, void(*pFuncDelayus)(UINT32_T delay), UINT32_T(*pFuncTimerTick)(void))
{
	return I2C_MSW_Init(I2Cx, pFuncDelayus,pFuncTimerTick);
}

///////////////////////////////////////////////////////////////////////////////
//////函		数：
//////功		能：
//////输入参数:
//////输出参数:
//////说		明：
//////////////////////////////////////////////////////////////////////////////
UINT8_T I2CLib_MSW_DeInit(I2C_HandleType *I2Cx)
{
	return I2C_MSW_DeInit(I2Cx);
}

///////////////////////////////////////////////////////////////////////////////
//////函		数：
//////功		能：
//////输入参数:
//////输出参数:
//////说		明： 返回的是应答信号
//////////////////////////////////////////////////////////////////////////////
UINT8_T I2CLib_MSW_START(I2C_HandleType *I2Cx, UINT8_T isWrite)
{
	//---发送启动信号
	I2C_MSW_START(I2Cx);
	//---判断是读取操作还是写入操作
	if (isWrite)
	{
		I2Cx->msgAddr &= 0xFE;
	}
	else
	{
		I2Cx->msgAddr |= 0x01;
	}
	//---发送从机地址
	I2C_MSW_SendByte(I2Cx, (UINT8_T)I2Cx->msgAddr);
	//---读取应答信号
	return I2C_MSW_ReadACK(I2Cx);
}

///////////////////////////////////////////////////////////////////////////////
//////函		数：
//////功		能：
//////输入参数:
//////输出参数:
//////说		明：
//////////////////////////////////////////////////////////////////////////////
UINT8_T I2CLib_MSW_STOP(I2C_HandleType *I2Cx)
{
	//---发送启动信号
	return	I2C_MSW_STOP(I2Cx);
}

///////////////////////////////////////////////////////////////////////////////
//////函		数：
//////功		能：
//////输入参数:
//////输出参数:
//////说		明：
//////////////////////////////////////////////////////////////////////////////
UINT8_T I2CLib_MSW_ACK(I2C_HandleType *I2Cx)
{
	return I2C_MSW_ACK(I2Cx);
}

///////////////////////////////////////////////////////////////////////////////
//////函		数：
//////功		能：
//////输入参数:
//////输出参数:
//////说		明：
//////////////////////////////////////////////////////////////////////////////
UINT8_T I2CLib_MSW_NACK(I2C_HandleType *I2Cx)
{
	return I2C_MSW_NACK(I2Cx);
}

///////////////////////////////////////////////////////////////////////////////
//////函		数：
//////功		能：
//////输入参数:
//////输出参数:
//////说		明：
//////////////////////////////////////////////////////////////////////////////
UINT8_T I2CLib_MSW_ReadACK(I2C_HandleType *I2Cx)
{
	return I2C_MSW_ReadACK(I2Cx);
}

///////////////////////////////////////////////////////////////////////////////
//////函		数：
//////功		能：
//////输入参数:
//////输出参数:
//////说		明：
//////////////////////////////////////////////////////////////////////////////
UINT8_T I2CLib_MSW_WaitACK(I2C_HandleType *I2Cx)
{
	return I2C_MSW_WaitACK(I2Cx);
}

///////////////////////////////////////////////////////////////////////////////
//////函		数：
//////功		能：
//////输入参数:
//////输出参数:
//////说		明：
//////////////////////////////////////////////////////////////////////////////
UINT8_T I2CLib_MSW_SendACK(I2C_HandleType *I2Cx, UINT8_T isNACK)
{
	return I2C_MSW_SendACK(I2Cx, isNACK);
}

///////////////////////////////////////////////////////////////////////////////
//////函		数：
//////功		能：
//////输入参数:
//////输出参数:
//////说		明：
//////////////////////////////////////////////////////////////////////////////
UINT8_T I2CLib_MSW_SendByte(I2C_HandleType *I2Cx, UINT8_T val)
{
	return I2C_MSW_SendByte(I2Cx, val);
}

///////////////////////////////////////////////////////////////////////////////
//////函		数：
//////功		能：
//////输入参数:
//////输出参数:
//////说		明：
//////////////////////////////////////////////////////////////////////////////
UINT8_T I2CLib_MSW_SendWord(I2C_HandleType *I2Cx, UINT16_T val)
{
	return  I2C_MSW_SendWord(I2Cx, val);
}
///////////////////////////////////////////////////////////////////////////////
//////函		数：
//////功		能：
//////输入参数:
//////输出参数:
//////说		明：
//////////////////////////////////////////////////////////////////////////////
UINT8_T I2CLib_MSW_SendBits(I2C_HandleType *I2Cx, UINT8_T *pVal, UINT8_T bitNum)
{
	return I2C_MSW_SendBits(I2Cx, pVal, bitNum);
}

///////////////////////////////////////////////////////////////////////////////
//////函		数：
//////功		能：
//////输入参数:
//////输出参数:
//////说		明：
//////////////////////////////////////////////////////////////////////////////
UINT8_T I2CLib_MSW_ReadByte(I2C_HandleType *I2Cx)
{
	return I2C_MSW_ReadByte(I2Cx);
}

///////////////////////////////////////////////////////////////////////////////
//////函		数：
//////功		能：
//////输入参数:
//////输出参数:
//////说		明：
//////////////////////////////////////////////////////////////////////////////
UINT8_T I2CLib_MSW_ReadBits(I2C_HandleType *I2Cx, UINT8_T *pVal, UINT8_T bitNum)
{
	return I2C_MSW_ReadBits(I2Cx, pVal, bitNum);
}

///////////////////////////////////////////////////////////////////////////////
//////函		数：
//////功		能：
//////输入参数:
//////输出参数:
//////说		明：
//////////////////////////////////////////////////////////////////////////////
UINT8_T I2CLib_MSW_CheckDevice(I2C_HandleType *I2Cx)
{
	return I2C_MSW_CheckDevice(I2Cx);
}

///////////////////////////////////////////////////////////////////////////////
//////函		数：
//////功		能：
//////输入参数:
//////输出参数:
//////说		明：
//////////////////////////////////////////////////////////////////////////////
UINT8_T I2CLib_MSW_SendCMD(I2C_HandleType *I2Cx, UINT8_T cmd, UINT8_T isStart, UINT8_T isStop)
{
	return I2C_MSW_SendCMD(I2Cx, cmd, isStart, isStop);
}

///////////////////////////////////////////////////////////////////////////////
//////函		数：
//////功		能：
//////输入参数:
//////输出参数:
//////说		明：
//////////////////////////////////////////////////////////////////////////////
UINT8_T I2CLib_MSW_Send(I2C_HandleType *I2Cx, UINT8_T *pVal, UINT16_T length)
{
	UINT8_T _return = OK_0;
	UINT16_T i = 0;

	//---发送启动信号并发送从机地址---写地址
	_return = I2CLib_MSW_START(I2Cx, 1);

	//---判断启动信号是否成功并同时决定是否发送数据
	if (_return == 0)
	{
		for (i = 0; i < length; i++)
		{
			//---发送数据
			I2CLib_MSW_SendByte(I2Cx, pVal[i]);

			//---读取应答信号
			_return = I2CLib_MSW_ReadACK(I2Cx);

			//---判断应答信号
			if (_return)
			{
				_return = (2 + i);
				break;
			}
		}
	}
	return _return;
}

///////////////////////////////////////////////////////////////////////////////
//////函		数：
//////功		能：
//////输入参数:
//////输出参数:
//////说		明：
//////////////////////////////////////////////////////////////////////////////
UINT8_T I2CLib_MSW_Read(I2C_HandleType *I2Cx, UINT8_T *pVal, UINT16_T length)
{
	UINT8_T _return = OK_0;
	UINT16_T i = 0;

	//---发送启动信号并发送从机地址---写地址
	_return = I2CLib_MSW_START(I2Cx, 1);

	//---判断启动信号是否成功并同时决定是否发送数据
	if (_return != OK_0)
	{
		goto GotoExit;
	}

	//---发送启动信号并发送从机地址---读取地址
	_return = I2CLib_MSW_START(I2Cx, 0);

	//---判断启动信号是否成功并同时决定是否发送数据
	if (_return != OK_0)
	{
		_return = ERROR_2;
		goto GotoExit;
	}
	for (i = 0; i < length; i++)
	{
		//---读取数据
		pVal[i] = I2CLib_MSW_ReadByte(I2Cx);
		if ((length - 1) == i)
		{
			_return = ERROR_3;
		}

		//---发送应答信号或则不应答信号
		I2CLib_MSW_SendACK(I2Cx, _return);
	}
	_return = OK_0;
GotoExit:
	return _return;
}

///////////////////////////////////////////////////////////////////////////////
//////函		数：
//////功		能：
//////输入参数:
//////输出参数:
//////说		明：
//////////////////////////////////////////////////////////////////////////////
UINT8_T I2CLib_MHW_Init(I2C_HandleType *I2Cx, void(*pFuncDelayus)(UINT32_T delay), UINT32_T(*pFuncTimerTick)(void))
{
	return I2C_MHW_Init(I2Cx,pFuncDelayus,pFuncTimerTick);
}

///////////////////////////////////////////////////////////////////////////////
//////函		数：
//////功		能：
//////输入参数:
//////输出参数:
//////说		明：
//////////////////////////////////////////////////////////////////////////////
UINT8_T I2CLib_MHW_DeInit(I2C_HandleType* I2Cx)
{
	return I2C_MHW_DeInit(I2Cx);
}

///////////////////////////////////////////////////////////////////////////////
//////函		数：
//////功		能：
//////输入参数:
//////输出参数:
//////说		明：
//////////////////////////////////////////////////////////////////////////////
UINT8_T I2CLib_MHW_PollMode_START(I2C_HandleType* I2Cx, UINT8_T isWrite)
{
	if (isWrite == 0)
	{	
		//---读取之前必须产生一个停止位，用于清除状态标识，否则容易发生状态错误现象
		I2C_MHW_PollMode_STOP(I2Cx);
	}
	//---检查busy信号
	if (I2C_MHW_CheckBusy(I2Cx) != 0)
	{
		return ERROR_2;
	}
	//---检查STOP信号，如果发生STOP则清楚STOP，否则容易发生异常
	I2C_MHW_CheckSTOP(I2Cx);
	//---发送START信号
	I2C_MHW_PollMode_START(I2Cx);
	//---等待ACK信号，类似读取ACK信号
	I2C_MHW_SendACK(I2Cx, 0);
	//---发送从设备地址
	return I2C_MHW_PollMode_ADDR(I2Cx, isWrite);
}

///////////////////////////////////////////////////////////////////////////////
//////函		数：
//////功		能：
//////输入参数:
//////输出参数:
//////说		明：
//////////////////////////////////////////////////////////////////////////////
UINT8_T I2CLib_MHW_PollMode_STOP(I2C_HandleType* I2Cx)
{
	return I2C_MHW_PollMode_STOP(I2Cx);
}

///////////////////////////////////////////////////////////////////////////////
//////函		数：
//////功		能：
//////输入参数:
//////输出参数:
//////说		明：
//////////////////////////////////////////////////////////////////////////////
UINT8_T I2CLib_MHW_CheckClock(I2C_HandleType* I2Cx)
{
	return I2C_MHW_CheckClock(I2Cx);
}

///////////////////////////////////////////////////////////////////////////////
//////函		数：
//////功		能：
//////输入参数:
//////输出参数:
//////说		明：
//////////////////////////////////////////////////////////////////////////////
UINT8_T I2CLib_MHW_SendACK(I2C_HandleType* I2Cx, UINT8_T isNACK)
{
	return I2C_MHW_SendACK(I2Cx, isNACK);
}

///////////////////////////////////////////////////////////////////////////////
//////函		数：
//////功		能：
//////输入参数:
//////输出参数:
//////说		明：
//////////////////////////////////////////////////////////////////////////////
UINT8_T I2CLib_MHW_PollMode_SendByte(I2C_HandleType* I2Cx, UINT8_T val, UINT8_T isBTF)
{
	return I2C_MHW_PollMode_SendByte(I2Cx, val, isBTF);
}

///////////////////////////////////////////////////////////////////////////////
//////函		数：
//////功		能：
//////输入参数:
//////输出参数:
//////说		明：
//////////////////////////////////////////////////////////////////////////////
UINT8_T I2CLib_MHW_PollMode_ReadByte(I2C_HandleType* I2Cx)
{
	return I2C_MHW_PollMode_ReadByte(I2Cx);
}

///////////////////////////////////////////////////////////////////////////////
//////函		数：
//////功		能：
//////输入参数:
//////输出参数:
//////说		明：
//////////////////////////////////////////////////////////////////////////////
UINT8_T I2CLib_Master_DeInit(I2C_HandleType* I2Cx)
{
	return I2C_Master_DeInit(I2Cx);
}